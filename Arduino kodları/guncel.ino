#include <Wire.h>
#include <Adafruit_GFX.h>
#include <Adafruit_SSD1306.h>
#include <Keypad.h>
#include <Encoder.h>
#include <HID-Project.h>

// ==========================================
// --- 1. SİSTEM VE EKRAN AYARLARI ---
// ==========================================
#define SCREEN_WIDTH 128
#define SCREEN_HEIGHT 64
#define OLED_RESET -1
Adafruit_SSD1306 display(SCREEN_WIDTH, SCREEN_HEIGHT, &Wire, OLED_RESET);

unsigned long sonIslemZamani = 0;   
const unsigned long BEKLEME_SURESI = 5000;

// --- HAREKET DEĞİŞKENLERİ ---
unsigned long oncekiZaman = 0;
const int hareketHizi = 100; // Milisaniye (Sayı küçüldükçe kedi daha hızlı titreşir/sallanır)
int kediY = 16;              // Kedinin başlangıç Y (dikey) konumu
int hareketYonu = 1;         // 1: Aşağı iniyor, -1: Yukarı çıkıyor
bool bostaMi = true;         // Herhangi bir tuşa basılmadığında true

bool micDurumu = true;
bool kameraDurumu = true;
bool kayitDurumu = false;

// ==========================================
// --- 2. 32x32 AMBLEMLER ---
// ==========================================

// --- SALLANAN KEDİ GÖRSELİ ---
const unsigned char kedi_kafa [] PROGMEM = {
  // image2cpp sitesinden aldığın HEX kodlarını buraya yapıştır
  0x00, 0x00, 0x00, 0x00, 0x00, 0x00, 0x00, 0x00, 0x00, 0x00, 0x00, 0x00, 0x00, 0x00, 0x00, 0x00, 
  0x00, 0x00, 0x00, 0x00, 0x00, 0x00, 0x00, 0x00, 0x00, 0x00, 0x00, 0x00, 0x00, 0x00, 0x00, 0x00, 
  0x00, 0x00, 0x00, 0x00, 0x00, 0x00, 0x00, 0x00, 0x00, 0x00, 0x00, 0x00, 0x00, 0x0e, 0x00, 0x00, 
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  0x00, 0x00, 0x00, 0x00, 0x00, 0x00, 0x00, 0x00
};

//const unsigned char ikon_kalp[] PROGMEM = {
//  0x00, 0x00, 0x00, 0x00, 0x00, 0x00, 0x00, 0x00, 0x07, 0xe0, 0x07, 0xe0, 0x1f, 0xf8, 0x1f, 0xf8,
//  0x3f, 0xfc, 0x3f, 0xfc, 0x7f, 0xfe, 0x7f, 0xfe, 0xff, 0xff, 0xff, 0xff, 0xff, 0xff, 0xff, 0xff,
//  0xff, 0xff, 0xff, 0xff, 0xff, 0xff, 0xff, 0xff, 0xff, 0xff, 0xff, 0xff, 0xff, 0xff, 0xff, 0xff,
  //0x7f, 0xff, 0xff, 0xfe, 0x3f, 0xff, 0xff, 0xfc, 0x1f, 0xff, 0xff, 0xf8, 0x0f, 0xff, 0xff, 0xf0,
  //0x07, 0xff, 0xff, 0xe0, 0x03, 0xff, 0xff, 0xc0, 0x01, 0xff, 0xff, 0x80, 0x00, 0xff, 0xff, 0x00,
  //0x00, 0x7f, 0xfe, 0x00, 0x00, 0x3f, 0xfc, 0x00, 0x00, 0x1f, 0xf8, 0x00, 0x00, 0x0f, 0xf0, 0x00,
  //0x00, 0x07, 0xe0, 0x00, 0x00, 0x03, 0xc0, 0x00, 0x00, 0x01, 0x80, 0x00, 0x00, 0x00, 0x00, 0x00,
  //0x00, 0x00, 0x00, 0x00, 0x00, 0x00, 0x00, 0x00, 0x00, 0x00, 0x00, 0x00, 0x00, 0x00, 0x00, 0x00
//};

const unsigned char ikon_mic_acik[] PROGMEM = {
  0x00, 0x00, 0x00, 0x00, 0x00, 0x00, 0x00, 0x00, 0x00, 0x03, 0xe0, 0x00, 0x00, 0x07, 0xf0, 0x00,
  0x00, 0x0f, 0xf8, 0x00, 0x00, 0x1f, 0xfc, 0x00, 0x00, 0x1f, 0xfc, 0x00, 0x00, 0x1f, 0xfc, 0x00,
  0x00, 0x1f, 0xfc, 0x00, 0x00, 0x1f, 0xfc, 0x00, 0x00, 0x1f, 0xfc, 0x00, 0x00, 0x9f, 0xfc, 0x80,
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  0x00, 0x3f, 0xfe, 0x00, 0x00, 0x3f, 0xfe, 0x00, 0x00, 0x00, 0x00, 0x00, 0x00, 0x00, 0x00, 0x00
};

const unsigned char ikon_mic_kapali[] PROGMEM = {
  0x00, 0x00, 0x00, 0x00, 0x00, 0x00, 0x00, 0x00, 0x00, 0x00, 0x00, 0x00, 0x00, 0x00, 0x00, 0x00,
  0x00, 0x00, 0x00, 0x00, 0x00, 0x00, 0x00, 0x00, 0x00, 0x00, 0x00, 0x00, 0x00, 0x00, 0x00, 0x00,
  0x00, 0x01, 0x80, 0x00, 0x00, 0x03, 0xc0, 0x00, 0x00, 0x07, 0xe8, 0x00, 0x00, 0x07, 0xf0, 0x00,
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  0x00, 0x00, 0x00, 0x00, 0x00, 0x00, 0x00, 0x00, 0x00, 0x00, 0x00, 0x00, 0x00, 0x00, 0x00, 0x00
};

const unsigned char ikon_up[] PROGMEM = {
  0xc0, 0x00, 0x00, 0x03, 0xc0, 0x00, 0x00, 0x03, 0xc0, 0x00, 0x00, 0x03, 0xc0, 0x01, 0x80, 0x03,
  0xc0, 0x07, 0xe0, 0x03, 0xc0, 0x0f, 0xf8, 0x03, 0xc0, 0x3f, 0xfe, 0x03, 0xc0, 0xff, 0xff, 0x03,
  0xc0, 0xff, 0x7f, 0x03, 0xc0, 0xfc, 0x1f, 0x03, 0xc0, 0xf0, 0x0f, 0x03, 0xc0, 0xc0, 0x03, 0x03,
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  0xc0, 0xc0, 0x03, 0x03, 0xc0, 0x00, 0x00, 0x03, 0xc0, 0x00, 0x00, 0x03, 0xc0, 0x00, 0x00, 0x03
};

const unsigned char ikon_down[] PROGMEM = {
  0xc0, 0x00, 0x00, 0x03, 0xc0, 0x00, 0x00, 0x03, 0xc0, 0x00, 0x00, 0x03, 0xc0, 0xc0, 0x03, 0x03,
  0xc0, 0xf0, 0x0f, 0x03, 0xc0, 0xfc, 0x1f, 0x03, 0xc0, 0xff, 0x7f, 0x03, 0xc0, 0xff, 0xff, 0x03,
  0xc0, 0x7f, 0xfe, 0x03, 0xc0, 0x0f, 0xf8, 0x03, 0xc0, 0x07, 0xe0, 0x03, 0xc0, 0x81, 0x81, 0x03,
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  0xc0, 0x01, 0x80, 0x03, 0xc0, 0x00, 0x00, 0x03, 0xc0, 0x00, 0x00, 0x03, 0xc0, 0x00, 0x00, 0x03
};

const unsigned char ikon_startstop[] PROGMEM = {
  0xff, 0xf0, 0x0f, 0xff, 0xff, 0x80, 0x01, 0xff, 0xfe, 0x00, 0x00, 0x7f, 0xfc, 0x00, 0x00, 0x3f,
  0xf8, 0x00, 0x00, 0x1f, 0xf0, 0x00, 0x00, 0x0f, 0xe0, 0x00, 0x00, 0x07, 0xc0, 0x00, 0x00, 0x03,
  0xc0, 0x00, 0x00, 0x03, 0x80, 0x00, 0x00, 0x01, 0x80, 0x00, 0x00, 0x01, 0x80, 0x00, 0xc3, 0x01,
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  0xfc, 0x00, 0x00, 0x3f, 0xfe, 0x00, 0x00, 0x7f, 0xff, 0x80, 0x01, 0xff, 0xff, 0xf0, 0x0f, 0xff
};

const unsigned char ikon_volmute[] PROGMEM = {
  0x3f, 0xff, 0xfe, 0x7f, 0x1f, 0xff, 0xfc, 0x7f, 0x8f, 0xff, 0xf0, 0x7f, 0xc7, 0xff, 0xe0, 0x7f,
  0xe3, 0xff, 0xc0, 0x7f, 0xf1, 0xff, 0x80, 0x7f, 0xf8, 0xfe, 0x00, 0x7f, 0xfc, 0x7c, 0x00, 0x7f,
  0xfe, 0x38, 0x00, 0x7f, 0xfc, 0x1c, 0x00, 0x7f, 0xf8, 0x0e, 0x00, 0x7f, 0xf8, 0x07, 0x00, 0x7f,
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  0xff, 0xff, 0xe0, 0x63, 0xff, 0xff, 0xf0, 0x71, 0xff, 0xff, 0xfc, 0x78, 0xff, 0xff, 0xfe, 0x7c
};

const unsigned char ikon_voldown[] PROGMEM = {
  0xff, 0xff, 0xff, 0xff, 0xff, 0xff, 0xff, 0xff, 0xff, 0xff, 0xff, 0xff, 0xff, 0xff, 0xff, 0xff, 
	0xff, 0xff, 0x3f, 0xff, 0xff, 0xfc, 0x1f, 0xff, 0xff, 0xf8, 0x1f, 0xff, 0xff, 0xf0, 0x1f, 0xff, 
	0xff, 0xe0, 0x0f, 0xff, 0xff, 0xc0, 0x0f, 0xff, 0xf0, 0x00, 0x0f, 0xff, 0xe0, 0x00, 0x0f, 0xff, 
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	0xff, 0xff, 0xff, 0xff, 0xff, 0xff, 0xff, 0xff, 0xff, 0xff, 0xff, 0xff, 0xff, 0xff, 0xff, 0xff
};

const unsigned char ikon_volup[] PROGMEM = {
  0xff, 0xff, 0xff, 0xff, 0xff, 0xff, 0xff, 0xff, 0xff, 0xff, 0xff, 0xff, 0xff, 0xff, 0x8f, 0xff, 
	0xff, 0xff, 0x0f, 0xff, 0xff, 0xfc, 0x0f, 0xff, 0xff, 0xf8, 0x0f, 0xff, 0xff, 0xe0, 0x0f, 0xff, 
	0xff, 0xc0, 0x0f, 0xff, 0xf8, 0x00, 0x0f, 0xff, 0xf0, 0x00, 0x0f, 0xff, 0xe0, 0x00, 0x0f, 0xff, 
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	0xff, 0xff, 0x8f, 0xff, 0xff, 0xff, 0xff, 0xff, 0xff, 0xff, 0xff, 0xff, 0xff, 0xff, 0xff, 0xff
};

const unsigned char ikon_dosya[] PROGMEM = {
  0x00, 0x00, 0x00, 0x00, 0x00, 0x00, 0x00, 0x00, 0x00, 0x00, 0x00, 0x00, 0x00, 0x00, 0x00, 0x00, 
	0x00, 0x00, 0x00, 0x00, 0x00, 0x00, 0x00, 0x00, 0x00, 0x00, 0x00, 0x00, 0x00, 0x00, 0x00, 0x00, 
	0x00, 0x00, 0x00, 0x00, 0x00, 0x00, 0x00, 0x00, 0x00, 0xfc, 0x00, 0x00, 0x00, 0xff, 0xf8, 0x00, 
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	0x00, 0x00, 0x00, 0x00, 0x00, 0x00, 0x00, 0x00, 0x00, 0x00, 0x00, 0x00, 0x00, 0x00, 0x00, 0x00
};

const unsigned char ikon_kilit[] PROGMEM = {
  0x00, 0x00, 0x00, 0x00, 0x00, 0x00, 0x00, 0x00, 0x00, 0x00, 0x00, 0x00, 0x00, 0x00, 0x00, 0x00, 
	0x00, 0x00, 0x00, 0x00, 0x00, 0x00, 0x00, 0x00, 0x00, 0x00, 0x00, 0x00, 0x00, 0x03, 0xc0, 0x00, 
	0x00, 0x07, 0xe0, 0x00, 0x00, 0x0c, 0x30, 0x00, 0x00, 0x08, 0x10, 0x00, 0x00, 0x08, 0x10, 0x00, 
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	0x00, 0x00, 0x00, 0x00, 0x00, 0x00, 0x00, 0x00, 0x00, 0x00, 0x00, 0x00, 0x00, 0x00, 0x00, 0x00
};

const unsigned char ikon_cut[] PROGMEM = {
  0x00, 0x00, 0x00, 0x00, 0x00, 0x00, 0x00, 0x00, 0x00, 0x00, 0x00, 0x00, 0x00, 0x00, 0x00, 0x00, 
	0x00, 0x00, 0x00, 0x00, 0x00, 0x00, 0x00, 0x00, 0x00, 0x08, 0x10, 0x00, 0x00, 0x08, 0x10, 0x00, 
	0x00, 0x08, 0x10, 0x00, 0x00, 0x0c, 0x30, 0x00, 0x00, 0x0c, 0x30, 0x00, 0x00, 0x06, 0x60, 0x00, 
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	0x00, 0x00, 0x00, 0x00, 0x00, 0x00, 0x00, 0x00, 0x00, 0x00, 0x00, 0x00, 0x00, 0x00, 0x00, 0x00
};

const unsigned char ikon_process[] PROGMEM = {
  0x00, 0x00, 0x00, 0x00, 0x00, 0x00, 0x00, 0x00, 0x00, 0x00, 0x00, 0x00, 0x00, 0x00, 0x00, 0x00, 
	0x00, 0x00, 0x00, 0x00, 0x00, 0x00, 0xc0, 0x00, 0x01, 0x21, 0xe0, 0x00, 0x01, 0xf1, 0x20, 0x00, 
	0x03, 0xf1, 0x20, 0x00, 0x0f, 0x1c, 0xdc, 0x00, 0x0e, 0x0c, 0x9c, 0x80, 0x06, 0x0d, 0xff, 0xc0, 
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	0x00, 0x00, 0x00, 0x00, 0x00, 0x00, 0x00, 0x00, 0x00, 0x00, 0x00, 0x00, 0x00, 0x00, 0x00, 0x00
};

const unsigned char ikon_klip[] PROGMEM = {
  0x00, 0x00, 0x00, 0x00, 0x00, 0x00, 0x00, 0x00, 0x00, 0x00, 0x00, 0x00, 0x00, 0x00, 0x00, 0x00, 
  0x00, 0x00, 0x00, 0x00, 0x00, 0x00, 0x00, 0x00, 0x00, 0x00, 0xc0, 0x00, 0x00, 0x00, 0xf0, 0x00, 
  0x00, 0x00, 0x78, 0x00, 0x00, 0x00, 0x3c, 0x00, 0x00, 0x00, 0xcc, 0x00, 0x00, 0x01, 0xf0, 0x00, 
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  0x00, 0x00, 0x00, 0x00, 0x00, 0x00, 0x00, 0x00, 0x00, 0x00, 0x00, 0x00, 0x00, 0x00, 0x00, 0x00
};

const unsigned char ikon_dc[] PROGMEM = {
  0x00, 0x00, 0x00, 0x00, 0x00, 0x00, 0x00, 0x00, 0x00, 0x00, 0x00, 0x00, 0x00, 0x00, 0x00, 0x00, 
  0x00, 0x00, 0x00, 0x00, 0x00, 0x00, 0x00, 0x00, 0x00, 0x00, 0x00, 0x00, 0x00, 0x00, 0x00, 0x00, 
  0x00, 0x00, 0x00, 0x00, 0x00, 0x00, 0x00, 0x00, 0x00, 0x00, 0x00, 0x00, 0x00, 0x3f, 0xfc, 0x00, 
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  0x00, 0x00, 0x00, 0x00, 0x00, 0x00, 0x00, 0x00, 0x00, 0x00, 0x00, 0x00, 0x00, 0x00, 0x00, 0x00
};

const unsigned char ikon_spoti[] PROGMEM = {
  0x00, 0x00, 0x00, 0x00, 0x00, 0x00, 0x00, 0x00, 0x00, 0x00, 0x00, 0x00, 0x00, 0x00, 0x00, 0x00, 
  0x00, 0x00, 0x00, 0x00, 0x00, 0x07, 0xe0, 0x00, 0x00, 0x3f, 0xfc, 0x00, 0x00, 0x7f, 0xfe, 0x00, 
  0x00, 0xff, 0xff, 0x00, 0x01, 0xff, 0xff, 0x80, 0x03, 0xff, 0xff, 0xc0, 0x03, 0x80, 0x0f, 0xc0, 
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  0x00, 0x00, 0x00, 0x00, 0x00, 0x00, 0x00, 0x00, 0x00, 0x00, 0x00, 0x00, 0x00, 0x00, 0x00, 0x00
};

const unsigned char ikon_kb[] PROGMEM = {
  0xff, 0xff, 0xff, 0xff, 0xff, 0xff, 0xff, 0xff, 0xff, 0xff, 0xff, 0xff, 0xff, 0xff, 0xff, 0xff, 
  0xff, 0xff, 0xff, 0xff, 0xff, 0xff, 0xff, 0xff, 0xfe, 0x3f, 0xfc, 0x3f, 0xfc, 0x7f, 0xfe, 0x3f, 
  0xfc, 0xff, 0xff, 0x3f, 0xfd, 0xff, 0xff, 0xbf, 0xff, 0xff, 0xff, 0xff, 0xff, 0xff, 0xff, 0xff, 
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  0xff, 0xff, 0xff, 0xff, 0xff, 0xff, 0xff, 0xff, 0xff, 0xff, 0xff, 0xff, 0xff, 0xff, 0xff, 0xff
};

const unsigned char ikon_kd[] PROGMEM = {
  0x00, 0x00, 0x00, 0x00, 0x00, 0x00, 0x00, 0x00, 0x00, 0x00, 0x00, 0x00, 0x00, 0x00, 0x00, 0x00, 
  0x0f, 0xff, 0xff, 0xf0, 0x0f, 0xff, 0xff, 0xf0, 0x0f, 0xff, 0xff, 0xf0, 0x0f, 0xff, 0xff, 0xf0, 
  0x0f, 0xff, 0xff, 0xf0, 0x0f, 0xff, 0xff, 0xf0, 0x0f, 0xff, 0xff, 0xf0, 0x0f, 0xff, 0xff, 0xf0, 
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  0x00, 0x00, 0x00, 0x00, 0x00, 0x00, 0x00, 0x00, 0x00, 0x00, 0x00, 0x00, 0x00, 0x00, 0x00, 0x00
};

const unsigned char ikon_camoff[] PROGMEM = {
  0xff, 0xff, 0xff, 0xff, 0x9f, 0xff, 0xff, 0xff, 0x8f, 0xff, 0xff, 0xff, 0xc7, 0xff, 0xff, 0xff, 
	0xe3, 0xff, 0xff, 0xff, 0xf1, 0xff, 0xff, 0xff, 0xf8, 0xff, 0xff, 0xff, 0x9c, 0x00, 0x01, 0xff, 
	0x0e, 0x00, 0x00, 0xff, 0x07, 0x00, 0x00, 0xf0, 0x03, 0x80, 0x00, 0xc0, 0x01, 0xc0, 0x00, 0x00, 
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	0xff, 0xff, 0xff, 0xe3, 0xff, 0xff, 0xff, 0xf1, 0xff, 0xff, 0xff, 0xf9, 0xff, 0xff, 0xff, 0xff
};

const unsigned char ikon_camon[] PROGMEM = {
  0x00, 0x00, 0x00, 0x00, 0x00, 0x00, 0x00, 0x00, 0x00, 0x00, 0x00, 0x00, 0x00, 0x00, 0x00, 0x00, 
	0x00, 0x00, 0x00, 0x00, 0x00, 0x00, 0x00, 0x00, 0x00, 0x00, 0x00, 0x00, 0x00, 0x00, 0x00, 0x00, 
	0x00, 0x00, 0x00, 0x00, 0x00, 0x00, 0x00, 0x00, 0x00, 0xff, 0xe0, 0x00, 0x01, 0xff, 0xf1, 0x80, 
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	0x00, 0x00, 0x00, 0x00, 0x00, 0x00, 0x00, 0x00, 0x00, 0x00, 0x00, 0x00, 0x00, 0x00, 0x00, 0x00
};

const unsigned char ikon_tik[] PROGMEM = {
  0xff, 0xff, 0xff, 0xff, 0xff, 0xfc, 0x3f, 0xff, 0xff, 0xc0, 0x03, 0xff, 0xff, 0x00, 0x00, 0xff, 
	0xfe, 0x00, 0x00, 0x7f, 0xfc, 0x00, 0x00, 0x3f, 0xf8, 0x00, 0x00, 0x1f, 0xf0, 0x00, 0x00, 0x0f, 
	0xe0, 0x00, 0x00, 0x07, 0xe0, 0x00, 0x00, 0x07, 0xc0, 0x00, 0x00, 0x03, 0xc0, 0x00, 0x0e, 0x03, 
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	0xff, 0x00, 0x00, 0xff, 0xff, 0xc0, 0x03, 0xff, 0xff, 0xfc, 0x3f, 0xff, 0xff, 0xff, 0xff, 0xff
};

// ==========================================
// --- 3. PİN AYARLARI ---
// ==========================================
const byte ROWS = 2;
const byte COLS = 5;
char keys[ROWS][COLS] = {
  { '1', '2', '3', '4', '5' },
  { '6', '7', '8', '9', '0' }
};
byte rowPins[ROWS] = { 4, 5 };
byte colPins[COLS] = { 6, A0, A1, A2, A3 };
Keypad keypad = Keypad(makeKeymap(keys), rowPins, colPins, ROWS, COLS);

Encoder enc1(7, 8);
Encoder enc2(10, 9);
const int enc1BtnPin = 14;
const int enc2BtnPin = 15;

// ==========================================
// --- 4. AKILLI ORTALAMA FONKSİYONU ---
// ==========================================
void ikonCiz(const unsigned char* ikon, String yazi1, String yazi2) {
  display.clearDisplay();

  // 1. İkonu Tam Ortaya Çiz (Ekran 128px, İkon 32px -> (128-32)/2 = X:48)
  display.drawBitmap(48, 2, ikon, 32, 32, WHITE);

  display.setTextSize(1);

  // 2. Matematiksel Yazi Ortalama Formülü
  // Her harf boyutu 6 pikseldir. (Ekran Genişliği - (Harf Sayısı * 6)) / 2
  int yazi1_X = (128 - (yazi1.length() * 6)) / 2;
  display.setCursor(yazi1_X, 38);
  display.print(yazi1);

  int yazi2_X = (128 - (yazi2.length() * 6)) / 2;
  display.setCursor(yazi2_X, 50);
  display.print(yazi2);

  display.display();
}

// ==========================================
// --- 5. SETUP ---
// ==========================================
void setup() {
  Consumer.begin();
  Keyboard.begin();

  pinMode(enc1BtnPin, INPUT_PULLUP);
  pinMode(enc2BtnPin, INPUT_PULLUP);

  if (display.begin(SSD1306_SWITCHCAPVCC, 0x3C)) {
    display.clearDisplay();
    display.setTextColor(WHITE);

    // Açılış yazısı da ortalansın
    display.setTextSize(2);
    String baslik = "MEOW DECK";
    int baslik_X = (128 - (baslik.length() * 12)) / 2;  // Boyut 2 olduğu için x12
    display.setCursor(baslik_X, 25);
    display.println(baslik);
    display.display();

    delay(2000);
    ikonCiz(ikon_tik, "SISTEM", "HAZIR");
    sonIslemZamani = millis();
  }
}

// ==========================================
// --- 6. LOOP ---
// ==========================================
void loop() {
  
  // 1. BOŞTA KALMA (IDLE) DURUMU VE KEDİ ANİMASYONU
  // Eğer son işlemden bu yana 5 saniye (BEKLEME_SURESI) geçtiyse kedi sallansın
  // BOŞTA KALMA - 56x56 SALLANAN DEV KEDİ
  if (millis() - sonIslemZamani > BEKLEME_SURESI) {
    unsigned long suankiZaman = millis();
    
    if (suankiZaman - oncekiZaman >= hareketHizi) {
      oncekiZaman = suankiZaman;
      
      display.clearDisplay(); 
      
      // X=36 (128-56=72, yarısı 36 ortalar), Y=kediY (Hareketli)
      display.drawBitmap(36, kediY, kedi_kafa, 56, 56, WHITE);
      display.display(); 
      
      kediY += hareketYonu;
      
      // Toplam 8 piksel boşluğumuz var (0 ile 8 arası)
      if (kediY >= 8) {         
        hareketYonu = -1; // Aşağı değdi, yukarı çık       
      } 
      else if (kediY <= 0) {    
        hareketYonu = 1;  // Yukarı değdi, aşağı in       
      }
    }
  }

  // 2. TUŞ TAKIMI KONTROLLERİ
  char key = keypad.getKey();
  if (key) {
    sonIslemZamani = millis(); // Herhangi bir tuşa basıldığında sayacı sıfırla (Kediyi gizle)

    switch (key) {

      case '1':
        micDurumu = !micDurumu;
        Keyboard.press(KEY_LEFT_CTRL);
        Keyboard.press(KEY_LEFT_SHIFT);
        Keyboard.press(KEY_LEFT_ALT);
        Keyboard.press('m');
        delay(50); 
        Keyboard.releaseAll(); 
        if (micDurumu) ikonCiz(ikon_mic_acik, "MIKROFON", "ACIK");
        else ikonCiz(ikon_mic_kapali, "MIKROFON", "KAPALI");
        break;

      case '2':
        kameraDurumu = !kameraDurumu;
        
        // İmkansız Kombinasyon: Ctrl + Shift + Alt + K
        Keyboard.press(KEY_LEFT_CTRL);
        Keyboard.press(KEY_LEFT_SHIFT);
        Keyboard.press(KEY_LEFT_ALT);
        Keyboard.press('k'); 
        
        delay(50);
        Keyboard.releaseAll();

        if (kameraDurumu) ikonCiz(ikon_camon, "KAMERA", "ACIK");
        else ikonCiz(ikon_camoff, "KAMERA", "KAPALI");
        break;

      case '3': 
        kayitDurumu = !kayitDurumu; 
        Keyboard.press(KEY_LEFT_CTRL); Keyboard.press(KEY_LEFT_ALT); Keyboard.press('s'); 
        delay(50); Keyboard.releaseAll();
        if(kayitDurumu) ikonCiz(ikon_kb, "KAYIT", "BASLADI"); 
        else ikonCiz(ikon_kd, "KAYIT", "DURDU");
        break;

      case '4': 
        Keyboard.press(KEY_LEFT_GUI); Keyboard.press('r');
        delay(50); Keyboard.releaseAll();
        delay(150); 
        
        // DÜZELTME: Soru işareti (?) yerine iki nokta üst üste (:) eklendi
        // Eğer klavyen iki nokta basmazsa Shift + Nokta kombinasyonunu dene
        Keyboard.print("spot'fy?"); 
        delay(50);
        Keyboard.press(KEY_ENTER);
        delay(50); Keyboard.releaseAll();
        ikonCiz(ikon_spoti, "SPOTIFY", "ACILIYOR");
        break;

      case '5': 
        Keyboard.press(KEY_LEFT_CTRL);
        Keyboard.press(KEY_LEFT_SHIFT);
        Keyboard.press(KEY_LEFT_ALT);
        Keyboard.press('d'); 
        delay(50); 
        Keyboard.releaseAll();
        ikonCiz(ikon_dc, "DISCORD", "ACILDI");
        break;

      case '6': 
        Keyboard.press(KEY_LEFT_ALT);
        Keyboard.press(KEY_F10);
        delay(50); 
        Keyboard.releaseAll();
        ikonCiz(ikon_klip, "KLIP", "ALINDI");
        break;

      case '7':
        Keyboard.press(KEY_LEFT_CTRL);
        Keyboard.press(KEY_LEFT_SHIFT);
        Keyboard.press(KEY_ESC);
        delay(50);
        Keyboard.releaseAll();
        ikonCiz(ikon_process, "GOREV", "YONETICISI");
        break;

      case '8':
        Keyboard.press('c');
        delay(50);
        Keyboard.releaseAll();
        ikonCiz(ikon_cut, "KURGU", "KESME ARACI");
        break;

      case '9':
        Keyboard.press(KEY_LEFT_GUI);
        Keyboard.press('l');
        delay(50);
        Keyboard.releaseAll();
        ikonCiz(ikon_kilit, "SISTEM", "KILITLENDI");
        break;

      case '0':
        Keyboard.press(KEY_LEFT_GUI);
        Keyboard.press('e');
        delay(50);
        Keyboard.releaseAll();
        ikonCiz(ikon_dosya, "DOSYA", "GEZGINI");
        break;
    }
  }

  // 3. ENKODER KONTROLLERİ
  long pos1 = enc1.read();
  if (pos1 >= 4) {
    sonIslemZamani = millis();
    Consumer.write(MEDIA_VOLUME_UP);
    ikonCiz(ikon_volup, "SES", "ARTTIRILDI");
    enc1.write(0);
  } else if (pos1 <= -4) {
    sonIslemZamani = millis();
    Consumer.write(MEDIA_VOLUME_DOWN);
    ikonCiz(ikon_voldown, "SES", "AZALTILDI");
    enc1.write(0);
  }

  if (digitalRead(enc1BtnPin) == LOW) {
    sonIslemZamani = millis();
    Consumer.write(MEDIA_VOLUME_MUTE);
    ikonCiz(ikon_volmute, "SES", "SUSTURULDU");
    delay(300);
  }

  long pos2 = enc2.read();
  if (pos2 >= 4) {
    sonIslemZamani = millis();
    Keyboard.write(KEY_DOWN_ARROW);
    ikonCiz(ikon_down, "SAYFA", "ASAGI");
    enc2.write(0);
  } else if (pos2 <= -4) {
    sonIslemZamani = millis();
    Keyboard.write(KEY_UP_ARROW);
    ikonCiz(ikon_up, "SAYFA", "YUKARI");
    enc2.write(0);
  }

  if (digitalRead(enc2BtnPin) == LOW) {
    sonIslemZamani = millis();
    Consumer.write(MEDIA_PLAY_PAUSE);
    ikonCiz(ikon_startstop, "MEDYA", "OYNAT/DUR");
    delay(300);
  }
}